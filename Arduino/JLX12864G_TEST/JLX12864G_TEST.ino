#include <SPI.h>

#define LCD_CS           5
#define LCD_RS          17
#define LCD_RSET        16
#define SPI_CLK         18
#define TFT_BACKLIGHT_PIN 15


//    Font Data
const char Font[192][5] =
{
    { 0x00, 0x00, 0x00, 0x00, 0x00 }, // " " 0x20
    { 0x00, 0x00, 0x4f, 0x00, 0x00 }, // !   0x21
    { 0x00, 0x07, 0x00, 0x07, 0x00 }, // "   0x22
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  { 0x06, 0x48, 0x40, 0x20, 0x1e } // so  0xBF

  
};


char v_buf[128][8];


SPISettings spiSettings = SPISettings(SPI_CLK, SPI_MSBFIRST, SPI_MODE1);


void Init_LCD()
{
    pinMode(LCD_CS, OUTPUT);
    digitalWrite(LCD_CS,HIGH);

    pinMode(LCD_RS, OUTPUT);
    digitalWrite(LCD_RS,HIGH);

    pinMode(LCD_RSET, OUTPUT);
    digitalWrite(LCD_RSET,LOW);
    delay(500);
    digitalWrite(LCD_RSET,HIGH);

    digitalWrite(LCD_CS,LOW);
    digitalWrite(LCD_RS,LOW);

    SPI.transfer(0xAE);  // display off
    SPI.transfer(0xA0);  // ADC normal ( Column address is left to right )
    SPI.transfer(0xC8);  // line scan is reverce ( bottom to top ) 
    SPI.transfer(0xA3);  // LCD bias = 1/7

    SPI.transfer(0x2C);  // Voltage supply up converter on 
    delay(50);
    SPI.transfer(0x2E);  // Voltage supply voltage regurator on
    delay(50);
    SPI.transfer(0x2F);  // foltage supply voltage follower on

    SPI.transfer(0x23);  // contrast rough (0x20-0x27)
    SPI.transfer(0x81);  // contrast trim command
    SPI.transfer(0x08);  // contrast trim data (0x00-0x3F) 

    SPI.transfer(0xA4);  // all dot displays: normal
    SPI.transfer(0x40);  // display start line set 0 (0x40-0x7F)
    SPI.transfer(0xA6);  // display normal/reverse: normal
    SPI.transfer(0xAF);  // display on

    digitalWrite(LCD_CS,HIGH);
}

void LCD_CLS(char data)
{
    int a,b;

    digitalWrite(LCD_CS,LOW);
    for(b=0; b<8; b ++) 
    {
        digitalWrite(LCD_RS,LOW);
        SPI.transfer(0xB0+b);  // page address 0xB0-0Xb8
        SPI.transfer(0x10);    // data0x10:0x00 means column address 0x00  
        SPI.transfer(0x00);

        digitalWrite(LCD_RS,HIGH);
        for(a=0; a<128; a++)
        {
            SPI.transfer(data);
            v_buf[a][b]=data;
        }
    }
    digitalWrite(LCD_CS,HIGH);
}


void LCD_PSET(int x_data, int y_data, int cl)
{

    int a,b;
    char c;

//  y_data
    a=y_data >> 3; b= y_data & 0x07;
    c=0x1;
    while(b)
    {
        c <<= 1; b --;
    }

    if(cl) v_buf[x_data][a] |= c;
    else
    {
        c = ~c; v_buf[x_data][a] &= c;
    }

    digitalWrite(LCD_CS,LOW);
    digitalWrite(LCD_RS,LOW);
    SPI.transfer(0xB0+a);
    c=x_data >> 4; c |= 0x10;
    SPI.transfer(c);
    c=x_data & 0xf;
    SPI.transfer(c);
    digitalWrite(LCD_RS,HIGH);
    SPI.transfer(v_buf[x_data][a]);
    digitalWrite(LCD_CS,HIGH);
}

void LCD_Print_Char(int x, int y, char mozi, int bw,int scale)
{
    int fontno,fontx,fonty,dot;
    char bitmask;

    fontno = mozi - 0x20;
    for(fontx=0; fontx<5; fontx ++)
    {
        bitmask=0x1;
        for(fonty=0; fonty<8; fonty ++)
        {
            if(Font[fontno][fontx] & bitmask){
              dot=1;
            } else {
              dot=0;
            }
            if(bw == 0)
            {
                if( 1 == dot){
                  dot=0;
                } else {
                  dot=1;
                }
            }
            for ( int dx=0; dx<scale;dx++) {
              for ( int dy=0; dy<scale;dy++) {
                LCD_PSET(x+fontx*scale+dx,  y + fonty*scale+dy  ,dot);
              }
            }
            bitmask <<= 1;
        }
    }
    
    for(fontx=0; fontx<1*scale; fontx ++)
    { 
      for(fonty=0; fonty<8*scale; fonty ++)
      {
        if(bw == 0) {
          dot=1;
        } else {
          dot=0;
        }
        LCD_PSET(x+7*scale+fontx,y + fonty,dot);
      }
    }
}

void LCD_Print(int x, int y, char *str, int bw,int scale)
{
    int len,i;
    len = strlen(str);
    for ( i=0; i<len;i++)
    {
        if(*str == 0xef) // for kana
        {
            str += 2;
            i += 2;
        }
        LCD_Print_Char(x,y,*str,bw,scale);
        x += 6*scale; str ++;
    }
}

void setup(void){


    pinMode(TFT_BACKLIGHT_PIN, OUTPUT);
    digitalWrite(TFT_BACKLIGHT_PIN,HIGH);
    
    SPI.begin();
    Init_LCD();
    LCD_CLS(0);  // zero clear
    LCD_Print(10,27,"JLX12864G Hello!",1,1);
    


}
void loop(void){

}
